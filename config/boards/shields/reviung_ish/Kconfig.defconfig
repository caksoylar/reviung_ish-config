## config/boards/shields/reviung_ish/Kconfig.defconfig
```kconfig
# Copyright (c) 2020 The ZMK Contributors
# SPDX-License-Identifier: MIT

if SHIELD_REVIUNG_ISH

config ZMK_KEYBOARD_NAME
    default "Reviung_ish"

endif
```

## config/boards/shields/reviung_ish/Kconfig.shield
```kconfig
# Copyright (c) 2020 The ZMK Contributors
# SPDX-License-Identifier: MIT

config SHIELD_REVIUNG_ISH
    def_bool $(shields_list_contains,reviung_ish)
```
